## conf/bblayers.conf
```bitbake
TOPDIR := "${@os.path.dirname(os.path.dirname(d.getVar('FILE', True)))}"

BBPATH = "${TOPDIR}"
BBLAYERS = "${TOPDIR}/openembedded"
```

## openembedded/conf/layer.conf
```bitbake
BBFILES += "${LAYERDIR}/recipes/*/*.bb"
BBPATH .= ":${LAYERDIR}"
# BBFILE_COLLECTIONS += "oe"
# BBFILE_PRIORITY_oe = "1"
# BBFILE_PATTERN_oe = "${LAYERDIR}"
```
